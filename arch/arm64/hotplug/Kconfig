## arch/arm64/hotplug/Kconfig
```kconfig
config MAKO_HOTPLUG
 	bool "Mako Hotplug"
 	default n
 	help
 	  Mako Hotplug: A custom hotplug by fransico franco

config MSM_SLEEPER
	bool "CPU hotplug driver"
	default y
	help
	  CPU hotplug driver
```
